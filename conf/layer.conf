## conf/layer.conf
```bitbake
# We have a conf and classes directory, add to BBPATH
BBPATH .= ":${LAYERDIR}"

# We have recipes-* directories, add to BBFILES
BBFILES += "${LAYERDIR}/recipes-*/*/*.bb \
            ${LAYERDIR}/recipes-*/*.bb \
            ${LAYERDIR}/recipes-*/*/*.bbappend \
            ${LAYERDIR}/recipes-*/*.bbappend"

BBFILE_COLLECTIONS += "meta-rdk-auxiliary"
BBFILE_PATTERN_meta-rdk-auxiliary = "^${LAYERDIR}/"
BBFILE_PRIORITY_meta-rdk-auxiliary = "6"

LAYERDEPENDS_meta-rdk-auxiliary = "core"
LAYERSERIES_COMPAT_meta-rdk-auxiliary = "dunfell"

require include/image-classes.inc
require include/user-classes.inc
```
